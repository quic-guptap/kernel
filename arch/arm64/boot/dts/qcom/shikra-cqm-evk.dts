// SPDX-License-Identifier: BSD-3-Clause
/*
 * Copyright (c) Qualcomm Technologies, Inc. and/or its subsidiaries.
 */

/dts-v1/;

#include "shikra-cqm-som.dtsi"

/ {
	model = "Qualcomm Technologies, Inc. Shikra CQM EVK";
	compatible = "qcom,shikra-cqm-evk", "qcom,shikra-cqm-som", "qcom,shikra";
	chassis-type = "embedded";

	aliases {
	};

	chosen {
		stdout-path = "serial0:115200n8";
	};
};
